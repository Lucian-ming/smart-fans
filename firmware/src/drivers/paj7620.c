/**
 * @file paj7620.c
 * @brief PAJ7620U2 手势传感器驱动实现
 */
#include "paj7620.h"
#include "i2c_bus.h"
#include "hal/delay_us.h"
#include "stm32f1xx_hal.h"
#include "config/pins.h"

#define PAJ7620_I2C_ADDR 0x73

static bool g_paj7620_present = false;

/* PAJ7620U2 官方完整标准初始化表 (Bank 0 + Bank 1 共 219 项配置) */
static const uint8_t init_register_array[][2] = {
    {0xEF, 0x00},
    {0x32, 0x29},
    {0x33, 0x01},
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    {0x7E, 0x01}
};

static void gesture_int_gpio_init(void)
{
    GPIO_InitTypeDef gpio = {0};

    __HAL_RCC_GPIOA_CLK_ENABLE();

    /* PA4: 手势中断输入引脚，PAJ7620 低有效开漏输出，故单片机侧配置上拉输入 */
    gpio.Pin = GESTURE_INT_Pin;
    gpio.Mode = GPIO_MODE_INPUT;
    gpio.Pull = GPIO_PULLUP;
    gpio.Speed = GPIO_SPEED_FREQ_LOW;
    HAL_GPIO_Init(GESTURE_INT_Port, &gpio);
}

bool paj7620_init(void)
{
    gesture_int_gpio_init();

    if (!i2c_bus_probe(PAJ7620_I2C_ADDR)) {
        g_paj7620_present = false;
        return false;
    }

    /* 唤醒传感器：先尝试切到 Bank 0 */
    i2c_bus_write_reg(PAJ7620_I2C_ADDR, 0xEF, 0x00);
    HAL_Delay(5);

    /* 校验 Part ID (寄存器 0x00 应为 0x20, 0x01 应为 0x76) */
    uint8_t id_buf[2] = {0};
    if (!i2c_bus_read_regs(PAJ7620_I2C_ADDR, 0x00, id_buf, 2)) {
        g_paj7620_present = false;
        return false;
    }

    uint16_t part_id = ((uint16_t)id_buf[1] << 8) | id_buf[0];
    if (part_id != 0x7620) {
        g_paj7620_present = false;
        return false;
    }

    /* 写入手势初始化配置表 */
    size_t array_len = sizeof(init_register_array) / sizeof(init_register_array[0]);
    for (size_t i = 0; i < array_len; i++) {
        i2c_bus_write_reg(PAJ7620_I2C_ADDR, init_register_array[i][0], init_register_array[i][1]);
    }

    /* 确保切回 Bank 0 准备读取结果 */
    i2c_bus_write_reg(PAJ7620_I2C_ADDR, 0xEF, 0x00);

    /* 清除上电残留中断标志 */
    uint8_t dummy0 = 0, dummy1 = 0;
    i2c_bus_read_regs(PAJ7620_I2C_ADDR, 0x43, &dummy0, 1);
    i2c_bus_read_regs(PAJ7620_I2C_ADDR, 0x44, &dummy1, 1);

    g_paj7620_present = true;
    return true;
}

bool paj7620_is_connected(void)
{
    return g_paj7620_present;
}

bool paj7620_has_interrupt(void)
{
    /* INT 为低有效 */
    return (HAL_GPIO_ReadPin(GESTURE_INT_Port, GESTURE_INT_Pin) == GPIO_PIN_RESET);
}

uint16_t paj7620_read_gesture(void)
{
    if (!g_paj7620_present) return PAJ7620_GESTURE_NONE;

    uint8_t d0 = 0, d1 = 0;
    /* 依次读取 0x43 (主手势) 与 0x44 (次级手势如 Wave)，并同时清除硬件中断锁存 */
    bool ok0 = i2c_bus_read_regs(PAJ7620_I2C_ADDR, 0x43, &d0, 1);
    bool ok1 = i2c_bus_read_regs(PAJ7620_I2C_ADDR, 0x44, &d1, 1);

    if (!ok0 && !ok1) return PAJ7620_GESTURE_NONE;

    if (d0 != 0) {
        return (uint16_t)d0;
    }
    if (ok1 && (d1 & 0x01)) {
        return PAJ7620_GESTURE_WAVE;
    }
    return PAJ7620_GESTURE_NONE;
}

const char* paj7620_gesture_to_str(uint16_t gesture)
{
    switch (gesture) {
    case PAJ7620_GESTURE_UP:            return "UP";
    case PAJ7620_GESTURE_DOWN:          return "DOWN";
    case PAJ7620_GESTURE_LEFT:          return "LEFT";
    case PAJ7620_GESTURE_RIGHT:         return "RIGHT";
    case PAJ7620_GESTURE_FORWARD:       return "FORWARD";
    case PAJ7620_GESTURE_BACKWARD:      return "BACKWARD";
    case PAJ7620_GESTURE_CLOCKWISE:     return "CLOCKWISE";
    case PAJ7620_GESTURE_COUNTER_CLOCK: return "COUNTER_CLOCK";
    case PAJ7620_GESTURE_WAVE:          return "WAVE";
    default:                            return "NONE";
    }
}
