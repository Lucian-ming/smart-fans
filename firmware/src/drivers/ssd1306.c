/**
 * @file ssd1306.c
 * @brief SSD1306 128x64 OLED 驱动实现
 */
#include "ssd1306.h"
#include "i2c_bus.h"
#include <string.h>
#include <stdio.h>

#define SSD1306_I2C_ADDR_DEFAULT 0x3C

static uint8_t g_ssd1306_addr = SSD1306_I2C_ADDR_DEFAULT;
static uint8_t g_ssd1306_buf[1024];
static bool g_ssd1306_display_on = true;

/* 6x8 紧凑 ASCII 字模 (0x20 ' ' ~ 0x7E '~') */
static const uint8_t font6x8[][6] = {
    {0x00, 0x00, 0x00, 0x00, 0x00, 0x00}, /* 0x20 Space */
    {0x00, 0x00, 0x5F, 0x00, 0x00, 0x00}, /* ! */
    {0x00, 0x07, 0x00, 0x07, 0x00, 0x00}, /* " */
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    {0x08, 0x08, 0x2A, 0x1C, 0x08, 0x00}  /* ~ */
};

static void write_cmd(uint8_t cmd)
{
    uint8_t buf[2] = {0x00, cmd}; /* 0x00: Co=0, D/C#=0 (Command) */
    i2c_bus_write(g_ssd1306_addr, buf, 2);
}

bool ssd1306_init(void)
{
    uint8_t target_addr = 0;
    if (i2c_bus_probe(0x3C)) {
        target_addr = 0x3C;
    } else if (i2c_bus_probe(0x3D)) {
        target_addr = 0x3D;
    } else {
        return false;
    }
    g_ssd1306_addr = target_addr;

    /* 标准 SSD1306 初始化时序 */
    write_cmd(0xAE); /* Display OFF */
    write_cmd(0xD5); /* Set Display Clock Divide Ratio */
    write_cmd(0x80);
    write_cmd(0xA8); /* Set Multiplex Ratio */
    write_cmd(0x3F); /* 1/64 duty */
    write_cmd(0xD3); /* Set Display Offset */
    write_cmd(0x00);
    write_cmd(0x40); /* Set Display Start Line = 0 */
    write_cmd(0x8D); /* Charge Pump Setting */
    write_cmd(0x14); /* Enable Charge Pump */
    write_cmd(0x20); /* Memory Addressing Mode */
    write_cmd(0x00); /* Horizontal Addressing Mode */
    write_cmd(0xA1); /* Segment Re-map (A0/A1) */
    write_cmd(0xC8); /* COM Output Scan Direction (C0/C8) */
    write_cmd(0xDA); /* Set COM Pins Hardware Config */
    write_cmd(0x12);
    write_cmd(0x81); /* Set Contrast Control */
    write_cmd(0xCF);
    write_cmd(0xD9); /* Set Pre-charge Period */
    write_cmd(0xF1);
    write_cmd(0xDB); /* Set VCOMH Deselect Level */
    write_cmd(0x40);
    write_cmd(0xA4); /* Output follows RAM content */
    write_cmd(0xA6); /* Normal display (non-inverted) */
    write_cmd(0xAF); /* Display ON */

    ssd1306_clear();
    ssd1306_update();
    return true;
}

void ssd1306_clear(void)
{
    memset(g_ssd1306_buf, 0x00, sizeof(g_ssd1306_buf));
}

void ssd1306_update(void)
{
    /* 设置列地址范围 0~127 */
    write_cmd(0x21);
    write_cmd(0);
    write_cmd(SSD1306_WIDTH - 1);

    /* 设置页地址范围 0~7 */
    write_cmd(0x22);
    write_cmd(0);
    write_cmd((SSD1306_HEIGHT / 8) - 1);

    /* 分批次写数据（每次 16 字节，首字节为 0x40 数据控制符） */
    uint8_t packet[17];
    packet[0] = 0x40; /* Data mode */

    for (uint16_t i = 0; i < 1024; i += 16) {
        memcpy(&packet[1], &g_ssd1306_buf[i], 16);
        i2c_bus_write(g_ssd1306_addr, packet, 17);
    }
}

static void draw_char(uint8_t x, uint8_t page, char c)
{
    if (x >= SSD1306_WIDTH || page >= (SSD1306_HEIGHT / 8)) return;
    if (c < 0x20 || c > 0x7E) c = ' ';

    const uint8_t *glyph = font6x8[c - 0x20];
    for (uint8_t i = 0; i < 6; i++) {
        if (x + i < SSD1306_WIDTH) {
            g_ssd1306_buf[page * SSD1306_WIDTH + (x + i)] = glyph[i];
        }
    }
}

void ssd1306_draw_string(uint8_t x, uint8_t page, const char *str)
{
    if (str == NULL) return;
    uint8_t cur_x = x;
    while (*str && cur_x < (SSD1306_WIDTH - 6)) {
        draw_char(cur_x, page, *str++);
        cur_x += 6;
    }
}

void ssd1306_show_status(const char *mode_str, float temp, float humi,
                         int8_t fan_speed, const char *servo_str,
                         const char *last_evt)
{
    char line[48];

    ssd1306_clear();

    /* 第0页：最醒目的系统工作模式展示 (MANUAL / AUTO_TEMP / STANDBY) */
    snprintf(line, sizeof(line), "[MODE] %-10s", mode_str ? mode_str : "STANDBY");
    ssd1306_draw_string(2, 0, line);

    /* 第2页：温湿度 */
    if (temp > -40.0f && humi >= 0.0f) {
        int t_int = (int)temp;
        int t_dec = (int)((temp - (float)t_int) * 10.0f);
        if (t_dec < 0) t_dec = -t_dec;
        int h_int = (int)humi;
        int h_dec = (int)((humi - (float)h_int) * 10.0f);
        if (h_dec < 0) h_dec = -h_dec;
        snprintf(line, sizeof(line), "T:%2d.%1dC  H:%2d.%1d%%", t_int, t_dec, h_int, h_dec);
    } else {
        snprintf(line, sizeof(line), "T: --.-C  H: --.-%%");
    }
    ssd1306_draw_string(2, 2, line);

    /* 第4页：风扇转速 */
    if (fan_speed == 0) {
        snprintf(line, sizeof(line), "Fan : STOP (0%%)");
    } else {
        snprintf(line, sizeof(line), "Fan : %3d%% [RUN]", fan_speed);
    }
    ssd1306_draw_string(2, 4, line);

    /* 第6页：摇头状态与最近按键 */
    snprintf(line, sizeof(line), "SWING: %-4s", servo_str ? servo_str : "OFF");
    ssd1306_draw_string(2, 6, line);

    /* 第7页：事件操作提示 */
    if (last_evt && strlen(last_evt) > 0) {
        snprintf(line, sizeof(line), "> %-14s", last_evt);
        ssd1306_draw_string(2, 7, line);
    }

    ssd1306_update();
}

void ssd1306_set_display_on(bool on)
{
    write_cmd(on ? 0xAF : 0xAE);
    g_ssd1306_display_on = on;
}

bool ssd1306_is_display_on(void)
{
    return g_ssd1306_display_on;
}
